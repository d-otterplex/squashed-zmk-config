## boards/arm/d12/Kconfig.defconfig
```kconfig
if BOARD_D12_LEFT

config ZMK_KEYBOARD_NAME
    default "d12"

config ZMK_SPLIT_ROLE_CENTRAL
    default y

config ZMK_USB
    default y

endif


if BOARD_D12_LEFT || BOARD_D12_RIGHT

config ZMK_SPLIT_WIRED
    default y

config SERIAL
    default y

config ZMK_KSCAN_DIRECT_POLLING
    default y

config UART_INTERRUPT_DRIVEN
    default y

config UART_LINE_CTRL
    default y
endif
```

## boards/shields/iso219-proto/Kconfig.defconfig
```kconfig
if SHIELD_ISO219_PROTO
      
config ZMK_KEYBOARD_NAME  
    default "iso219-proto"

endif
```

## boards/shields/uniplus/uniplus_defconfig
```kconfig
# SPDX-License-Identifier: Apache-2.0

CONFIG_EC11=y
CONFIG_EC11_TRIGGER_GLOBAL_THREAD=y
```
